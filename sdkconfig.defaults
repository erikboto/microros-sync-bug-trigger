## sdkconfig.defaults
```kconfig
CONFIG_ESPTOOLPY_FLASHSIZE_4MB=y
CONFIG_PARTITION_TABLE_CUSTOM=y
CONFIG_ESP_EVENT_LOOP_PROFILING=y
CONFIG_ESP_CONSOLE_UART_CUSTOM=y
CONFIG_ESP_CONSOLE_UART_CUSTOM_NUM_1=y
CONFIG_ESP_CONSOLE_UART_TX_GPIO=26
CONFIG_ESP_CONSOLE_UART_RX_GPIO=25
CONFIG_ESP32_WIFI_STATIC_RX_BUFFER_NUM=16
CONFIG_ESP32_WIFI_TX_BA_WIN=20
CONFIG_ESP32_WIFI_RX_BA_WIN=20
CONFIG_FREERTOS_HZ=1000
```
